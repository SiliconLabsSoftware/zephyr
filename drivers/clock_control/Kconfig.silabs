## drivers/clock_control/Kconfig.silabs
```kconfig
# Copyright (c) 2024 Silicon Laboratories Inc.
# SPDX-License-Identifier: Apache-2.0

config CLOCK_CONTROL_SILABS_SERIES
	bool "Silicon Labs Series 2+ clock control driver"
	default y
	depends on DT_HAS_SILABS_SERIES_CLOCK_ENABLED
	select SILABS_SISDK_CLOCK_MANAGER
	help
	  Enable Silicon Labs Series 2+ Clock Management Unit clock control driver.

config CLOCK_SILABS_EFR32_MCO
	bool "Silicon Labs EFR32 CMU Clock Output (MCO/MCLK) driver"
	default y
	depends on DT_HAS_SILABS_EFR32_CMU_CLKOUT_ENABLED
	help
	  Configure CMU CLKOUT pins to output internal clocks (HFRCODPLL, HFXO,
	  etc.) for external use, e.g. MCLK for audio codecs.
```

## drivers/i2s/Kconfig.efr32_usart
```kconfig
# Copyright (c) 2026 Silicon Laboratories Inc.
# SPDX-License-Identifier: Apache-2.0

menuconfig I2S_SILABS_EFR32_USART
	bool "Silicon Labs EFR32 USART I2S (Series 2)"
	default y
	depends on DT_HAS_SILABS_EFR32_USART_I2S_ENABLED
	depends on DT_HAS_SILABS_LDMA_ENABLED
	depends on CLOCK_CONTROL
	depends on DMA
	select PINCTRL
	select DMA_SILABS_LDMA
	select SILABS_SISDK_USART
	select SILABS_SISDK_PRS
	help
	  I2S over USART synchronous mode with I2SCTRL enabled (EFR32xG2x and
	  similar). Audio data is transferred using the SoC LDMA controller
	  (requires ``dmas`` / ``dma-names`` on the USART I2S devicetree node).

if I2S_SILABS_EFR32_USART

config I2S_SILABS_EFR32_USART_TX_BLOCK_COUNT
	int "TX queue depth (memory blocks)"
	default 4
	range 2 16

config I2S_SILABS_EFR32_USART_RX_BLOCK_COUNT
	int "RX queue depth (memory blocks)"
	default 4
	range 2 16

endif # I2S_SILABS_EFR32_USART
```

## dts/bindings/clock/silabs,efr32-cmu-clkout.yaml
```yaml
# Copyright (c) 2026 Silicon Laboratories Inc.
# SPDX-License-Identifier: Apache-2.0

compatible: "silabs,efr32-cmu-clkout"

description: |
  Silicon Labs EFR32 Series 2 CMU Clock Output (MCO).

  Routes an internal clock source to a GPIO pin via the CMU EXPORTCLKCTRL
  block.  Select a source, optionally divide by a prescaler, and 
  the clock will appear on the pin.

  Example — MCLK = SYSCLK / 4 from HFRCODPLL 76.8 MHz (= 19.2 MHz):

      silabs_cmu_clkout {
          compatible = "silabs,efr32-cmu-clkout";
          status = "okay";
          silabs,clkout-source = "expclk";
          silabs,clkout-prescaler = <4>;
          silabs,clkout-gpio-port = <3>;
          silabs,clkout-gpio-pin = <3>;
      };

include: [base.yaml]

properties:
  silabs,clkout-source:
    type: string
    required: true
    enum:
      - "disabled"
      - "hfrcodpll"
      - "hfxo"
      - "expclk"
      - "fsrco"
      - "lfrco"
      - "lfxo"
      - "ulfrco"
      - "hclk"
    description: |
      Internal clock source muxed to the CLKOUT pin.  Use "expclk" to
      route HFRCODPLL through the EXPORTCLKCTRL prescaler.

  silabs,clkout-prescaler:
    type: int
    default: 1
    description: |
      EXPORTCLKCTRL prescaler (1..32).  Output frequency = source / prescaler.

  silabs,clkout-gpio-port:
    type: int
    required: true
    description: |
      GPIO port index (0 = PA, 1 = PB, 2 = PC, 3 = PD) for the CLKOUT pin.

  silabs,clkout-gpio-pin:
    type: int
    required: true
    description: |
      Pin number (0..15) within the GPIO port.
```

## dts/bindings/clock/silabs,series-clock-clkout.yaml
```yaml
# Copyright (c) 2026 Silicon Laboratories Inc.
# SPDX-License-Identifier: Apache-2.0

title: Silicon Labs Series 2 CMU CLKOUT (MCO)

description: |
  A single CMU CLKOUT output (MCO), declared as a child of a
  "silabs,series-clock" (cmu) node.

  The clock referenced by "clocks" is routed to a GPIO pin. The pin itself is
  configured through the parent cmu node's pinctrl-0 using the CMU_CLKOUTx_Pyy
  pinctrl signals, so "reg" (the CLKOUT output index 0, 1 or 2) must match the
  CMU_CLKOUTx signal selected in pinctrl.

  Example (MCLK = SYSCLK / 4 = 19.2 MHz on CLKOUT2 / PB0):

      &pinctrl {
          clkout_default: clkout_default {
              group0 {
                  pins = <CMU_CLKOUT2_PB0>;
                  drive-push-pull;
              };
          };
      };

      &cmu {
          #address-cells = <1>;
          #size-cells = <0>;
          pinctrl-0 = <&clkout_default>;
          pinctrl-names = "default";

          clkout@2 {
              reg = <2>;
              clocks = <&exportclk>;
              clock-div = <4>;
          };
      };

compatible: "silabs,series-clock-clkout"

include: [base.yaml]

properties:
  reg:
    required: true
    description: CLKOUT output index (0, 1 or 2).

  "#clock-cells":
    type: int
    const: 0
    description: |
      This node is also a clock provider so a consumer (for example the I2S
      driver for codec MCLK) can gate the output at runtime via
      clock_control_on()/clock_control_off().

  clocks:
    type: phandle-array
    required: true
    description: |
      Clock source routed to the CLKOUT pin. Reference a CMU clock source node
      (for example &hfxo, &hfrcodpll, &lfxo, &lfrco) or &exportclk to use the
      divided HFEXPCLK (EXPORTCLK) branch.

  clock-div:
    type: int
    default: 1
    description: |
      EXPORTCLK (HFEXPCLK) prescaler, 1..32. Only applied when "clocks" points
      to the exportclk node. Output frequency = source / clock-div.
```

## dts/bindings/clock/silabs,series2-exportclk.yaml
```yaml
# Copyright (c) 2026 Silicon Laboratories Inc.
# SPDX-License-Identifier: Apache-2.0

title: Silicon Labs Series 2 CMU EXPORTCLK (HFEXPCLK) branch

description: |
  Marker node for the CMU HFEXPCLK export-clock branch (SYSCLK with an
  additional prescaler). Reference it from a "silabs,series-clock-clkout"
  node's "clocks" property to route the divided export clock to a CLKOUT pin;
  the prescaler is taken from that node's "clock-div".

compatible: "silabs,series2-exportclk"

include: [base.yaml]

properties:
  "#clock-cells":
    type: int
    const: 0
```

## dts/bindings/test/silabs,i2s-clock-measure.yaml
```yaml
# Copyright (c) 2026 Silicon Laboratories Inc.
# SPDX-License-Identifier: Apache-2.0

description: |
  Optional I2S clock capture inputs for the i2s_silabs_efr32_usart Unity test image.

  On EFR32xG27 the USART bit clock is measured by routing BCLK to a GPIO on the
  expansion header (jumper). The Unity test samples edges with k_cycle_get_32().
  LRCLK is sampled on the USART word-select pin (PC3 on RB4194A) without a jumper.

  Example wiring on xG27-RB4194A (see board ``exp-header`` gpio-map):

    EXP pin 8  (PC2, USART0 CLK / BCLK)  --->  EXP pin 12 (PA5, capture)
    EXP pin 10 (PC3, USART0 CS / LRCLK) --->  EXP pin 14 (PA6, capture)

compatible: "silabs,i2s-clock-measure"

include: [base.yaml]

properties:
  bclk-capture-port:
    type: int
    required: true
    description: GPIO port index (0 = A, 1 = B, 2 = C) for the BCLK capture input.

  bclk-capture-pin:
    type: int
    required: true
    description: Pin number on bclk-capture-port (0-15).

  lrclk-capture-port:
    type: int
    required: true
    description: GPIO port index for the LRCLK / WS capture input.

  lrclk-capture-pin:
    type: int
    required: true
    description: Pin number on lrclk-capture-port.

  bclk-src-exp-pin:
    type: int
    description: Expansion-header pin number where USART BCLK is routed (doc only).

  lrclk-src-exp-pin:
    type: int
    description: Expansion-header pin number where USART LRCLK is routed (doc only).

  bclk-cap-exp-pin:
    type: int
    description: Expansion-header pin number of the BCLK capture GPIO (doc only).

  lrclk-cap-exp-pin:
    type: int
    description: Expansion-header pin number of the LRCLK capture GPIO (doc only).
```

## modules/hal_silabs/simplicity_sdk/Kconfig
```kconfig
# Copyright (c) 2025 Silicon Laboratories Inc.
# SPDX-License-Identifier: Apache-2.0

menu "SiSDK configuration"
	depends on HAS_SILABS_SISDK

# Peripherals

config SILABS_SISDK_ACMP
	bool "Peripheral HAL for ACMP"

config SILABS_SISDK_BURTC
	bool "Peripheral HAL for BURTC"

config SILABS_SISDK_CORE
	bool "Peripheral HAL for CORE"

config SILABS_SISDK_EMU
	bool "Peripheral HAL for EMU"

config SILABS_SISDK_EUSART
	bool "Peripheral HAL for EUSART"

config SILABS_SISDK_GPIO
	bool "Peripheral HAL for GPIO"

config SILABS_SISDK_I2C
	bool "Peripheral HAL for I2C"

config SILABS_SISDK_IADC
	bool "Peripheral HAL for IADC"
	select SILABS_SISDK_SYSTEM

config SILABS_SISDK_LDMA
	bool "Peripheral HAL for LDMA"

config SILABS_SISDK_LETIMER
	bool "Peripheral HAL for LETIMER"

config SILABS_SISDK_MSC
	bool "Peripheral HAL for MSC"

config SILABS_SISDK_PRS
	bool "Peripheral HAL for PRS"

config SILABS_SISDK_RMU
	bool "Peripheral HAL for RMU"

config SILABS_SISDK_RTCC
	bool "Peripheral HAL for RTCC"

config SILABS_SISDK_SE
	bool "Peripheral HAL for SE (Secure Engine)"

config SILABS_SISDK_SYSTEM
	bool "Peripheral HAL for SYSTEM (device info)"

config SILABS_SISDK_TIMER
	bool "Peripheral HAL for TIMER"

config SILABS_SISDK_USART
	bool "Peripheral HAL for USART"

config SILABS_SISDK_VDAC
	bool "Peripheral HAL for VDAC"

config SILABS_SISDK_WDOG
	bool "Peripheral HAL for WDOG"

# Utilities

config SILABS_SISDK_SLIST
	bool

# Services

config SILABS_SISDK_CLOCK_MANAGER
	bool "Clock Manager service"
	help
	  Set if the Clock Manager HAL module is used.

config SILABS_SISDK_DEVICE_INIT
	bool "Device Init service"
	select SILABS_SISDK_EMU
	help
	  Use the device initialization routines from the device_init service
	  in Silicon Labs HAL.

config SILABS_SISDK_HFXO_MANAGER
	bool "HFXO Manager service"
	help
	  Set if the HFXO Manager HAL module is used.

config SILABS_SISDK_POWER_MANAGER
	bool "Power Manager service"
	select SILABS_SISDK_EMU
	select SILABS_SISDK_SLIST
	help
	  Set if the Power Manager HAL module is used.

config SILABS_SISDK_SLEEPTIMER
	bool "Sleeptimer service"
	select SILABS_SISDK_PRS
	select SILABS_SISDK_RTCC if $(dt_nodelabel_enabled,rtcc0)
	help
	  Set if the Sleeptimer HAL module is used.

# Radio

config SILABS_SISDK_RAIL_PA_CURVE_HEADER
	string "RAIL PA custom curve header file"
	default "pa_curves_efr32.h"
	help
	  Name of custom PA curve header file for use by PA initialization.
	  See AN1127 for information on how to create a custom PA curve.
	  The header file must be available on the include path.

config SILABS_SISDK_RAIL_PA_CURVE_TYPES_HEADER
	string "RAIL PA curve types header file"
	default "pa_curve_types_efr32.h"
	help
	  Name of custom PA curve type header file for use by PA initialization.
	  See AN1127 for information on how to create a custom PA curve.
	  The header file must be available on the include path.

config SILABS_SISDK_RAIL_PA_ENABLE_CALIBRATION
	bool "RAIL PA: apply factory calibration offset"
	default y
	help
	  Ensure that the PA power remains constant chip-to-chip by applying factory
	  calibration. This option is enabled by default, and is recommended for all
	  Series 2 devices.

config SILABS_SISDK_RAIL_MULTIPROTOCOL
	bool "Use RAIL Multiprotocol library"
	depends on SOC_GECKO_USE_RAIL
	help
	  Enable the Silicon Labs RAIL multiprotocol library, which provides
	  coexistence and arbitration between multiple wireless protocols (for
	  example, Bluetooth LE and a proprietary 2.4 GHz stack) on Gecko SoCs.

config SILABS_SISDK_PROTOCOL_CRYPTO
	bool
	depends on SOC_GECKO_HAS_RADIO

config SILABS_SISDK_OPENTHREAD_EFR32
	bool "Use Silicon Labs EFR32 Openthread platform abstraction"
	depends on OPENTHREAD
	select SOC_GECKO_USE_RAIL
	select SILABS_SISDK_PROTOCOL_CRYPTO
	select OPENTHREAD_SETTINGS_RAM
	help
	  Use the Silicon Labs EFR32 platform abstraction layer for OpenThread.

config SILABS_SISDK_OPENTHREAD_CRYPTO_PSA
	bool "Use Silicon Labs OpenThread Crypto PSA Settings"
	select OPENTHREAD_ECDSA
	select OPENTHREAD_MBEDTLS
	select OPENTHREAD_CRYPTO_PSA
	select OPENTHREAD_PLATFORM_KEYS_EXPORTABLE_ENABLE
	select MBEDTLS_PSA_CRYPTO_CLIENT
	select MBEDTLS_PSA_CRYPTO_C
	select PSA_WANT_KEY_TYPE_AES
	select PSA_WANT_ALG_CCM
	select PSA_WANT_ALG_CBC_NO_PADDING
	select PSA_WANT_ALG_CMAC
	select PSA_WANT_ALG_SHA_256
	select PSA_WANT_ALG_ECB_NO_PADDING
	select PSA_WANT_ALG_ECDSA
	select PSA_WANT_ALG_ECDH
	select PSA_WANT_KEY_TYPE_ECC_PUBLIC_KEY
	select PSA_WANT_ECC_SECP_R1_192
	select PSA_WANT_ECC_SECP_R1_224
	select PSA_WANT_ECC_SECP_R1_256
	select PSA_WANT_KEY_TYPE_ECC_KEY_PAIR_BASIC
	select PSA_WANT_KEY_TYPE_ECC_KEY_PAIR_IMPORT
	select PSA_WANT_KEY_TYPE_ECC_KEY_PAIR_EXPORT
	select PSA_WANT_KEY_TYPE_ECC_KEY_PAIR_GENERATE
	select PSA_WANT_ALG_DETERMINISTIC_ECDSA
	select PSA_WANT_ALG_HKDF
	select PSA_WANT_ALG_HMAC
	select PSA_WANT_KEY_TYPE_HMAC
	select PSA_WANT_ALG_JPAKE
	select PSA_WANT_ALG_PBKDF2_AES_CMAC_PRF_128
	select PSA_WANT_ALG_TLS12_PRF
	select PSA_WANT_ALG_TLS12_PSK_TO_MS
	help
	  Use the Silicon Labs Openthread Crypto PSA Settings.

endmenu
```

## tests/drivers/i2s/i2s_silabs_efr32_usart/testcase.yaml
```yaml
common:
  tags: drivers i2s unity
tests:
  drivers.i2s.silabs_efr32_usart.unity:
    build_only: true
    filter: dt_alias_exists("i2s-tx")
    platform_allow:
      - xg27_dk2602a
      - xg27_rb4194a
    integration_platforms:
      - xg27_dk2602a
      - xg27_rb4194a
```
